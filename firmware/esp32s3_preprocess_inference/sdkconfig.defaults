## firmware/esp32s3_preprocess_inference/sdkconfig.defaults
```kconfig
CONFIG_ESP_MAIN_TASK_STACK_SIZE=12288
CONFIG_LOG_DEFAULT_LEVEL_INFO=y
CONFIG_COMPILER_CXX_EXCEPTIONS=n
CONFIG_COMPILER_CXX_RTTI=n

# Use the ESP32S3 optimized ESP-DSP implementation and allocate only the
# coefficient table needed by the 512-point preprocessing FFT.
CONFIG_DSP_OPTIMIZED=y
CONFIG_DSP_MAX_FFT_SIZE_512=y
```

## firmware/esp32s3_tflm_smoke/sdkconfig.defaults
```kconfig
CONFIG_ESP_MAIN_TASK_STACK_SIZE=8192
CONFIG_LOG_DEFAULT_LEVEL_INFO=y
CONFIG_COMPILER_CXX_EXCEPTIONS=n
CONFIG_COMPILER_CXX_RTTI=n
```
